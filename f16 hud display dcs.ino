#include <TFT_eSPI.h>
#include <SPI.h>

#define DCSBIOS_DEFAULT_SERIAL
#include "DcsBios.h"


#define SCREEN_WIDTH  160
#define SCREEN_HEIGHT 128

TFT_eSPI tft = TFT_eSPI();

static const uint16_t PROGMEM image_battery_pixels[] = {0x0000,0x0000,0x0000,0x0000,0x0000,0x0000,0x0000,0x0000,0x0000,0x0000,0x0000,0x0000,0x0000,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0x0000,0x0000};

static const uint16_t PROGMEM image_geardown_pixels[] = {0x0000,0x0000,0x0000,0x0000,0x0000,0x0000,0x0000,0x0000,0x0000,0x0000,0x0000,0x0000,0x0000,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0x0000,0x0000};

static const unsigned char PROGMEM image_arrow_curved_right_up_bits[] = {0x20,0x70,0xf8,0x20,0x60,0x40,0x80};

static const uint16_t PROGMEM image_gearup_pixels[] = {0x0000,0x0000,0x0000,0x0000,0x0000,0x0000,0x0000,0x0000,0x0000,0x0000,0x0000,0x0000,0x0000,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0x0000,0x0000};

#define TACH_IDLE 8700
#define TACH_MAX  57000

bool alimentare = 0;
volatile bool uiDirty = false;          // setat când se schimbă date
unsigned long lastUiUpdate = 0;
const unsigned long UI_REFRESH_MS = 40;

unsigned int fuel_100 = 0;    // 0–65535, corespunzator cifra 100
unsigned int fuel_1k = 0;     // 0–65535, corespunzator cifra 1K
unsigned int fuel_10k = 0;    // 0–65535, corespunzator cifra 10K

unsigned int fuel_total = 0;  // valoarea combinata X*10k + Y*1K + Z*100
int combustibil = 0;          // procent final reprezinta nivelul de combustibil
bool poz_flaps = false;        //reprezinta pozitia flapsului (deschis sau inchis)
bool poz_frana = false;        //reprezinta valoarea franei de aer (airbrake)
int acc = 0;   //reprezinta valoarea throttle
bool poz_gear = false;        // false = gear down, true = gear up

unsigned int frana_stanga = 0;
unsigned int frana_dreapta = 0;

unsigned int engine_tach = 0;   // valoarea actuala de la Engine Tachometer
/*unsigned int nozzle_pos = 0;    // valoarea actuala de la Nozzle Position

const unsigned int tach_values[]   = {0, 8700, 26580, 34300, 39400, 44200, 47600, 50000, 52000, 54000, 57000, 57000, 57000};
const unsigned int nozzle_values[] = {0, 0, 58300, 4800, 129, 129, 129, 129, 129, 129, 129, 15000, 22500};
const unsigned int throttle_values[] = {0, 15, 20, 30, 40, 50, 60, 70, 80, 90, 100, 110, 120};
const int TABLE_SIZE = sizeof(tach_values) / sizeof(tach_values[0]);*/


bool lastFlaps = false;
bool lastPowerState = false;
bool lastGearState = false;

void onGearHandleChange(unsigned int newValue) {
    // newValue va fi 0 sau 1
    poz_gear = (newValue == 1);
    uiDirty = true;
}
DcsBios::IntegerBuffer gearHandleBuffer(0x441c, 0x8000, 15, onGearHandleChange);

void onMainPwrSwChange(unsigned int newValue) {
    alimentare = (newValue != 0);
    uiDirty = true;
}
DcsBios::IntegerBuffer mainPwrSwBuffer(0x441c, 0x0003, 0, onMainPwrSwChange);

void onAltFlapsSwChange(unsigned int newValue) {
    poz_flaps = (newValue == 1);
    uiDirty = true;
}
DcsBios::IntegerBuffer altFlapsSwBuffer(0x4400, 0x0002, 1, onAltFlapsSwChange);

void onExtSpeedBrakeLeftChange(unsigned int newValue) {
    frana_stanga = newValue;
    // Actualizam poz_frana imediat
    poz_frana = (frana_stanga > 100 || frana_dreapta > 100);
    uiDirty = true;
}
DcsBios::IntegerBuffer extSpeedBrakeLeftBuffer(0x45c0, 0xffff, 0, onExtSpeedBrakeLeftChange);

void onExtSpeedBrakeRightChange(unsigned int newValue) {
    frana_dreapta = newValue;
    // Actualizam poz_frana imediat
    poz_frana = (frana_stanga > 100 || frana_dreapta > 100);
    uiDirty = true;
}
DcsBios::IntegerBuffer extSpeedBrakeRightBuffer(0x45be, 0xffff, 0, onExtSpeedBrakeRightChange);

int convertFuelDigit(unsigned int rawValue) {
    // convertim 0–65535 in 1–9
    int val = (rawValue * 9) / 65535 + 1;
    if(val > 9) val = 9;    // siguranță
    if(val < 1) val = 1;
    return val;
}

void onFueltotalizer100Change(unsigned int newValue) {
    fuel_100 = convertFuelDigit(newValue);
    updateFuelTotal();
    uiDirty = true;
}
DcsBios::IntegerBuffer fueltotalizer100Buffer(0x44f2, 0xffff, 0, onFueltotalizer100Change);

void onFueltotalizer1kChange(unsigned int newValue) {
    fuel_1k = convertFuelDigit(newValue);
    updateFuelTotal();
    uiDirty = true;
}
DcsBios::IntegerBuffer fueltotalizer1kBuffer(0x44f0, 0xffff, 0, onFueltotalizer1kChange);

void onFueltotalizer10kChange(unsigned int newValue) {
    fuel_10k = convertFuelDigit(newValue);
    updateFuelTotal();
    uiDirty = true;
}
DcsBios::IntegerBuffer fueltotalizer10kBuffer(0x44ee, 0xffff, 0, onFueltotalizer10kChange);

void onEngineTachometerChange(unsigned int newValue) {
    engine_tach = newValue;
    updateThrottle();
    uiDirty = true;
}
DcsBios::IntegerBuffer engineTachometerBuffer(0x44de, 0xffff, 0, onEngineTachometerChange);

/*void onEngineNozzlePositionChange(unsigned int newValue) {
    nozzle_pos = newValue;
    updateThrottle();
    uiDirty = true;
} 
DcsBios::IntegerBuffer engineNozzlePositionBuffer(0x44dc, 0xffff, 0, onEngineNozzlePositionChange);*/

/*void updateThrottle() {
    float throttle_interp = 0.0f;

    // găsim intervalul în care se află engine_tach
    int index = 0;
    while(index < TABLE_SIZE - 1 && engine_tach > tach_values[index+1]) {
        index++;
    }

    if(index >= TABLE_SIZE - 1) {
        // depășit ultimul interval → folosim ultima valoare
        throttle_interp = throttle_values[TABLE_SIZE - 1];
    } else {
        // Interpolare liniară între index și index+1
        unsigned int t0 = tach_values[index];
        unsigned int t1 = tach_values[index + 1];
        unsigned int n0 = nozzle_values[index];
        unsigned int n1 = nozzle_values[index + 1];
        unsigned int throttle0 = throttle_values[index];
        unsigned int throttle1 = throttle_values[index + 1];

        float factor = 0.0f;

        if(t1 != t0) {
            factor = float(engine_tach - t0) / float(t1 - t0);
        }

        // interpolăm și nozzle_pos pentru a avea mai mult realism
        float nozzle_interp = n0 + factor * (n1 - n0);

        // verificăm dacă nozzle_pos este aproape de interpolare (poți adăuga prag)
        float nozzle_factor = 1.0f;
        if(n1 != n0) {
            nozzle_factor = float(nozzle_pos - n0) / float(n1 - n0);
            if(nozzle_factor < 0) nozzle_factor = 0;
            if(nozzle_factor > 1) nozzle_factor = 1;
        }

        throttle_interp = throttle0 + (throttle1 - throttle0) * nozzle_factor;
    }

    // Convertim 0–120% în 0–99%
    acc = int(throttle_interp * 99.0f / 120.0f);
    
    // Limităm între 0 și 99%
    if(acc > 99) acc = 99;
    if(acc < 0) acc = 0;
    
}*/

void updateThrottle() {
    int tach = engine_tach;

    // Sub idle → 0%
    if (tach <= TACH_IDLE) {
        acc = 0;
        return;
    }

    // Peste max → 99%
    if (tach >= TACH_MAX) {
        acc = 99;
        return;
    }

    // Calcul procent
    acc = (tach - TACH_IDLE) * 99 / (TACH_MAX - TACH_IDLE);

    // Siguranță
    acc = constrain(acc, 0, 99);
}


void updateFuelTotal() {
    // Fuel_Total = X*10k + Y*1K + Z*100
    fuel_total = fuel_10k * 10000 + fuel_1k * 1000 + fuel_100 * 100;

    // Procent
    combustibil = (fuel_total * 100) / 12113;

    // Limitam intre 1 si 99%
    if(combustibil > 99) combustibil = 99;
    if(combustibil < 1)  combustibil = 1;

    // Optional: actualizeaza UI imediat
    //updateUI();
}

// ===== LED WARNINGS & AOA =====

// AOA Indicators
DcsBios::LED lightAoaDn(0x447a, 0x2000, 32);   // Galben
DcsBios::LED lightAoaMid(0x447a, 0x1000, 33);  // Verde
DcsBios::LED lightAoaUp(0x447a, 0x0800, 25);   // Rosu

// Master Caution
DcsBios::LED lightMasterCaution(0x447a, 0x0001, 27);

// Airspeed / Takeoff Config Warning
DcsBios::LED lightToLdgConfig(0x447a, 0x0100, 14);


void poweroff(void) {
    tft.fillScreen(0x0);
    // imagine baterie
    tft.pushImage(40, 64, 48, 32, image_battery_pixels);
    // Layer 2
    tft.setTextColor(0xFFFF);
    tft.setTextSize(1);
    tft.setFreeFont();
    tft.drawString("PLANE POWER", 32, 42);
    // Layer 3
    tft.setTextSize(2);
    tft.drawString("OFF", 47, 109);
}

void poweron() {
    tft.fillScreen(0x0);

    // Linii orizontale
    tft.drawLine(0, 50, 127, 50, 0x7E0);
    tft.drawLine(0, 49, 127, 49, 0x7E0);
    tft.drawLine(0, 48, 127, 48, 0x7E0);

    // Text comun
    tft.setTextColor(0x7E0);
    tft.setTextSize(1);
    tft.setFreeFont();

    // Etichete
    tft.drawString("Fuel Level", 65, 108);
    tft.drawString("Flaps", 14, 72);
    tft.drawString("RPM", 85, 72);
    tft.drawString("F16-C Viper", 32, 146);
    tft.drawString("AirBrake", 5, 108);

    tft.setTextColor(0xFFFF);
    tft.drawString("LANDING GEAR", 23, 53);
    tft.drawBitmap(100, 53, image_arrow_curved_right_up_bits, 5, 7, 0xFFFF);

    // Valori temporare INIT (până sunt actualizate)
    tft.setTextColor(0xFFFF);  // alb pentru valori
    tft.setTextSize(1);

    tft.drawString("INIT", 79, 120); // Fuel
    tft.drawString("INIT", 79, 84);  // Throttle
    tft.drawString("INIT", 11, 84);  // Flaps
    tft.drawString("INIT", 11, 120); // AirBrake

    // Inițializare tren aterizare - doar text INIT până se actualizează
    tft.setTextSize(3);
    tft.setTextColor(0xFFFF);
    tft.pushImage(11, 3, 104, 41, image_geardown_pixels);
}

void updateUI() {
    // Fuel
    tft.setTextColor(TFT_WHITE, 0x0);
    tft.setTextSize(2);
    tft.fillRect(78, 120, 30, 16, 0x0000); // curăță zona înainte
    combustibil = constrain(combustibil, 1, 99);
    tft.drawString(String(combustibil) + "%", 78, 120);

    // Flaps
    tft.fillRect(11, 84, 30, 16, 0x0000);
    tft.drawString(poz_flaps ? "ON " : "OFF", 11, 84);

    // Throttle
    tft.fillRect(78, 84, 30, 16, 0x0000);
    acc=constrain(acc,1,99);
    tft.drawString(String(acc) + "%", 78, 84);

    // AirBrake
    tft.fillRect(11, 120, 30, 16, 0x0000);
    tft.drawString(poz_frana ? "ON " : "OFF", 11, 120);
    
    if (poz_gear != lastGearState) {
        lastGearState = poz_gear;
        if (poz_gear)
            tft.pushImage(11, 3, 104, 36, image_gearup_pixels);
        else
            tft.pushImage(11, 3, 104, 41, image_geardown_pixels);
    }
}

void setup() {
    // Serial pentru DCS-BIOS (OBLIGATORIU exact 250000)
    Serial.begin(250000);

    // Inițializare DCS-BIOS
    DcsBios::setup();

    // Inițializare display
    tft.init();
    //tft.setRotation(1);   // dacă ai nevoie (opțional)
    tft.fillScreen(TFT_BLACK);

    // Reset stări interne
    lastPowerState = false;
    uiDirty = true;       // forțăm primul redraw
    lastUiUpdate = 0;

    // Afișare inițială
    poweroff();
}

void loop() {
    DcsBios::loop();

    unsigned long now = millis();

    // Detectăm schimbarea alimentării
    if (alimentare != lastPowerState) {
        lastPowerState = alimentare;

        if (alimentare)
            poweron();
        else
            poweroff();

        uiDirty = true;   // forțăm redraw
    }

    // UI update:
    // 1) dacă s-au schimbat datele
    // 2) SAU dacă au trecut >40ms
    if (uiDirty || (now - lastUiUpdate >= UI_REFRESH_MS)) {
        lastUiUpdate = now;
        uiDirty = false;

        if (alimentare)
            updateUI();
        // dacă nu e alimentare, poweroff() deja e afișat
    }
}

